#include <SoftwareSerial.h>

// --- CONFIGURATION DU BLUETOOTH ---
// RX Arduino (D2) <--> TX Bluetooth
// TX Arduino (D3) <--> RX Bluetooth
SoftwareSerial BT(2, 3); 

// --- CONFIGURATION DES MOTEURS ---
// Moteur GAUCHE
const int IN1 = 5;
const int IN2 = 6;
// Moteur DROIT
const int IN3 = 9;
const int IN4 = 10;

char commande = 'S'; // Variable pour stocker l'ordre reçu

void setup() {
  // Démarrage des communications
  Serial.begin(9600); // Pour l'ordinateur (au cas où)
  BT.begin(9600);     // Pour le téléphone (Important !)

  // Configuration des broches moteurs en SOTRIE
  pinMode(IN1, OUTPUT);
  pinMode(IN2, OUTPUT);
  pinMode(IN3, OUTPUT);
  pinMode(IN4, OUTPUT);

  Serial.println("Robot Bluetooth Pret !");
}

void loop() {
  // Est-ce que le téléphone parle ?
  if (BT.available()) {
    commande = BT.read(); // On lit la lettre envoyée
    Serial.println(commande); // On l'affiche sur l'ordi pour vérifier
  }

  // --- CERVEAU DU ROBOT ---
  if (commande == 'F') {       // F = Forward (Avancer)
    avancer();
  } 
  else if (commande == 'B') {  // B = Back (Reculer)
    reculer();
  } 
  else if (commande == 'L') {  // L = Left (Gauche)
    tournerGauche();
  } 
  else if (commande == 'R') {  // R = Right (Droite)
    tournerDroite();
  } 
  else if (commande == 'S') {  // S = Stop
    stopper();
  }
}

// --- FONCTIONS DE MOUVEMENT ---

void avancer() {
  digitalWrite(IN1, HIGH);
  digitalWrite(IN2, LOW);
  digitalWrite(IN3, HIGH);
  digitalWrite(IN4, LOW);
}

void reculer() {
  digitalWrite(IN1, LOW);
  digitalWrite(IN2, HIGH);
  digitalWrite(IN3, LOW);
  digitalWrite(IN4, HIGH);
}

void tournerGauche() {
  digitalWrite(IN1, LOW);  // Roue gauche recule
  digitalWrite(IN2, HIGH);
  digitalWrite(IN3, HIGH); // Roue droite avance
  digitalWrite(IN4, LOW);





































































































































































































































































































































































































































































































































































































































































































































  
}

void tournerDroite() {
  digitalWrite(IN1, HIGH); // Roue gauche avance
  digitalWrite(IN2, LOW);
  digitalWrite(IN3, LOW);  // Roue droite recule
  digitalWrite(IN4, HIGH);
}

void stopper() {
  digitalWrite(IN1, LOW);
  digitalWrite(IN2, LOW);
  digitalWrite(IN3, LOW);
  digitalWrite(IN4, LOW);
}